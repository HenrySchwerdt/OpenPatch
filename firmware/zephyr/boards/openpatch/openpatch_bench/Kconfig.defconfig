## firmware/zephyr/boards/openpatch/openpatch_bench/Kconfig.defconfig
```kconfig
# SPDX-License-Identifier: Apache-2.0

if BOARD_OPENPATCH_BENCH

config HW_STACK_PROTECTION
	default ARCH_HAS_STACK_PROTECTION

endif # BOARD_OPENPATCH_BENCH
```

## firmware/zephyr/boards/openpatch/openpatch_bench/board.yml
```yaml
board:
  name: openpatch_bench
  full_name: OpenPatch Rev A bench controller (nRF52840 module, USB powered)
  vendor: openpatch
  socs:
  - name: nrf52840
```

## firmware/zephyr/boards/openpatch/openpatch_reva/board.yml
```yaml
board:
  name: openpatch_reva
  full_name: OpenPatch Rev A (Insight SiP ISP1807 / nRF52840)
  vendor: openpatch
  socs:
  - name: nrf52840
```
